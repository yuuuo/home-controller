
#include <Arduino.h>
#include <IRremoteESP8266.h>
#include <IRsend.h>
#include <ESP8266WiFi.h>
#include <WiFiClient.h>
#include <ESP8266WebServer.h>
#include <ESP8266mDNS.h>
#include <ArduinoJson.h>
#include <SPI.h>
#include <SparkFunBME280.h>
#include <ArduinoOTA.h>
#include "arduino_secret.h"

uint16_t LightOff[83] = {3554, 1614, 536, 320, 532, 320, 532, 1186, 536, 1186, 536, 320, 532,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 320, 506};
uint16_t LightOn[85] = {2206, 808,  5640, 902,  1608, 412,  1604, 412,  608, 420,  602, 420,  520,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 412,  492};

uint16_t AC20[375] = {3430, 1604,  494, 1188,  488, 1188,  520, 320,  492, 346,  490, 346,  492,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 1186,  494};
uint16_t AC26[375] = {3432, 1608, 462, 1212, 466, 1212, 492, 346, 494, 346, 492, 346, 492,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 1186, 492};   // UNKNOWN 80D3CBE8
uint16_t AC27[375] = {3406, 1634, 466, 1212, 462, 1212, 466, 372, 466, 372, 466, 372, 468,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 1268, 410}; // UNKNOWN 38342480
uint16_t AC28[375] = {3430, 1608, 492, 1186, 468, 1208, 492, 346, 492, 346, 492, 346, 494,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 1186, 494};    // UNKNOWN 3277D7A4
uint16_t ACOff[375] = {3432, 1604, 492, 1186, 492, 1186, 488, 350, 490, 346, 492, 346, 494,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 1190, 490};     // UNKNOWN 7F6DD306

const char *ssid = STASSID;
const char *password = STAPSK;

const uint16_t kIrLed = 16;

ESP8266WebServer server(80);
IRsend irsend(kIrLed);
BME280 bme280;

void handleLight()
{
  server.sendHeader("Access-Control-Allow-Headers", "Content-Type");
  if (server.method() != HTTP_POST)
  {
    server.send(204);
  }
  else
  {

    StaticJsonDocument<200> doc;
    DeserializationError error = deserializeJson(doc, server.arg("plain"));
    if (error)
    {
      server.send(400, "application/json", String("{result: \"error\", message: \"") + String(error.c_str()) + String("\"}"));
      return;
    }
    if (doc["status"])
    {
      irsend.sendRaw(LightOn, 83, 38);
    }
    else
    {
      irsend.sendRaw(LightOff, 83, 38);
    }

    server.send(200, "text/plane", "{result: \"success\", message: \"success\"}");
  }
}

void handleAC()
{
  server.sendHeader("Access-Control-Allow-Headers", "Content-Type");
  if (server.method() != HTTP_POST)
  {
    server.send(204);
  }
  else
  {

    StaticJsonDocument<200> doc;
    DeserializationError error = deserializeJson(doc, server.arg("plain"));
    if (error)
    {
      server.send(400, "application/json", String("{result: \"error\", message: \"") + String(error.c_str()) + String("\"}"));
      return;
    }
    if (doc["status"])
    {
      float temperature = doc["temperature"];
      if (temperature == 28.0)
      {
        irsend.sendRaw(AC28, 375, 38);
      }
      else if (temperature == 27.0)
      {
        irsend.sendRaw(AC27, 375, 38);
      }
      else if (temperature == 26.0)
      {
        irsend.sendRaw(AC26, 375, 38);
      }
      else if (temperature == 20.0)
      {
        irsend.sendRaw(AC20, 375, 38);
      }
      else
      {
        server.send(400, "application/json", "{result: \"error\", message: \"incompatible temperature\"}");
        return;
      }
    }
    else
    {
      irsend.sendRaw(ACOff, 375, 38);
    }

    server.send(200, "application/json", "{result: \"success\", message: \"success\"}");
  }
}

void handleEnvironment()
{
  server.sendHeader("Access-Control-Allow-Headers", "Content-Type");
  if (server.method() != HTTP_GET)
  {
    server.send(204);
  }
  else
  {
    float humidity = bme280.readFloatHumidity();
    float pressure = bme280.readFloatPressure();
    float temperature = bme280.readTempC();
    server.send(200, "application/json", String("{\"humidity\": ") + String(humidity) + String(", \"pressure\": ") + String(pressure) + String(", \"temperature\": ") + String(temperature) + String("}"));
  }
}

void handleNotFound()
{
  String message = "File Not Found\n\n";
  message += "URI: ";
  message += server.uri();
  message += "\nMethod: ";
  message += (server.method() == HTTP_GET) ? "GET" : "POST";
  message += "\nArguments: ";
  message += server.args();
  message += "\n";
  for (uint8_t i = 0; i < server.args(); i++)
  {
    message += " " + server.argName(i) + ": " + server.arg(i) + "\n";
  }
  server.send(404, "application/json", message);
}

void setup()
{
  irsend.begin();
  Serial.begin(115200);
  WiFi.config(IPAddress(192, 168, 11, 52), IPAddress(192, 168, 11, 1), IPAddress(255, 255, 255, 0));
  WiFi.begin(ssid, password);

  while (WiFi.status() != WL_CONNECTED)
  {
    delay(500);
    Serial.print(".");
  }

  Serial.println("");
  Serial.print("Connected to ");
  Serial.println(ssid);
  Serial.print("IP address: ");
  Serial.println(WiFi.localIP());

  ArduinoOTA.onStart([]()
  {
    String type;
    if (ArduinoOTA.getCommand() == U_FLASH)
    {
      type = "sketch";
    }
    else
    { // U_FS
      type = "filesystem";
    }

    // NOTE: if updating FS this would be the place to unmount FS using FS.end()
    Serial.println("Start updating " + type);
  });
  ArduinoOTA.onEnd([]()
  {
    Serial.println("\nEnd");
  });
  ArduinoOTA.onProgress([](unsigned int progress, unsigned int total)
  {
    Serial.printf("Progress: %u%%\r", (progress / (total / 100)));
  });
  ArduinoOTA.onError([](ota_error_t error)
  {
    Serial.printf("Error[%u]: ", error);
    if (error == OTA_AUTH_ERROR)
    {
      Serial.println("Auth Failed");
    }
    else if (error == OTA_BEGIN_ERROR)
    {
      Serial.println("Begin Failed");
    }
    else if (error == OTA_CONNECT_ERROR)
    {
      Serial.println("Connect Failed");
    }
    else if (error == OTA_RECEIVE_ERROR)
    {
      Serial.println("Receive Failed");
    }
    else if (error == OTA_END_ERROR)
    {
      Serial.println("End Failed");
    }
  });
  ArduinoOTA.begin();

  if (!MDNS.begin("irsender") || bme280.beginSPI(4) == false)
  {
    Serial.println("Connection Failed! Rebooting...");
    delay(5000);
    ESP.restart();
  }

  Serial.println("MDNS responder started");
  MDNS.addService("http", "tcp", 80);

  server.enableCORS(true);
  server.on("/light/", handleLight);
  server.on("/air-conditioner/", handleAC);
  server.on("/environment/", handleEnvironment);

  server.onNotFound(handleNotFound);

  server.begin();
  Serial.println("HTTP server started");
}

void loop()
{
  MDNS.update();
  server.handleClient();
  ArduinoOTA.handle();
}
